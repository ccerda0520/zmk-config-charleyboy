## boards/shields/charleyboy/Kconfig.defconfig
```kconfig
if SHIELD_CHARLEYBOY_LEFT

config ZMK_KEYBOARD_NAME
    default "charleyboy"

config ZMK_SPLIT_ROLE_CENTRAL
    default y

endif # SHIELD_CHARLEYBOY_LEFT

if SHIELD_CHARLEYBOY_LEFT || SHIELD_CHARLEYBOY_RIGHT

config ZMK_SPLIT
    default y

endif # SHIELD_CHARLEYBOY_LEFT || SHIELD_CHARLEYBOY_RIGHT
```

## boards/shields/charleyboy/Kconfig.shield
```kconfig
config SHIELD_CHARLEYBOY_LEFT
    def_bool $(shields_list_contains,charleyboy_left)

config SHIELD_CHARLEYBOY_RIGHT
    def_bool $(shields_list_contains,charleyboy_right)
```
