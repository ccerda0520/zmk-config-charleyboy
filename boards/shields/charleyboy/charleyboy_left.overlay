// This file was generated from a template. Edit it to match your keyboard.
// See https://zmk.dev/docs/development/hardware-integration/new-shield for more
// instructions.

#include "charleyboy.dtsi"

/ {
    chosen {
        zmk,matrix-transform = &left_transform;
    };
};

left_transform: left_transform {
    compatible = "zmk,matrix-transform";
    rows = <5>;
    columns = <6>;

    map = <
        RC(0,0) RC(0,1) RC(0,2) RC(0,3) RC(0,4) RC(0,5)
        RC(1,0) RC(1,1) RC(1,2) RC(1,3) RC(1,4) RC(1,5)
        RC(2,0) RC(2,1) RC(2,2) RC(2,3) RC(2,4) RC(2,5)
        RC(3,0) RC(3,1) RC(3,2) RC(3,3) RC(3,4) RC(3,5)
                RC(4,1) RC(4,2) RC(4,3) RC(4,4) RC(4,5)
    >;
};
